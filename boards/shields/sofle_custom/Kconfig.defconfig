## boards/shields/sofle_custom/Kconfig.defconfig
```kconfig
# Copyright (c) 2020 Ryan Cross
# SPDX-License-Identifier: MIT

if SHIELD_SOFLE_CUSTOM_DONGLE

config ZMK_KEYBOARD_NAME
    default "Sofle Custom"

config ZMK_SPLIT
    default y

config ZMK_SPLIT_ROLE_CENTRAL
    default y

config ZMK_SPLIT_BLE_CENTRAL_PERIPHERALS
    default 2

config BT_MAX_CONN
    default 7

config BT_MAX_PAIRED
    default 7

if ZMK_RGB_UNDERGLOW

config WS2812_STRIP
    default y

endif # ZMK_RGB_UNDERGLOW

if ZMK_BACKLIGHT

config PWM
    default y

config LED_PWM
    default y

endif # ZMK_BACKLIGHT

endif # SHIELD_SOFLE_CUSTOM_DONGLE

if SHIELD_SOFLE_CUSTOM_LEFT || SHIELD_SOFLE_CUSTOM_RIGHT

config ZMK_SPLIT
    default y

if ZMK_DISPLAY

config I2C
    default y

config SSD1306
    default y

endif # ZMK_DISPLAY

if SSD1306

config LV_Z_VDB_SIZE
    default 64

config LV_DPI_DEF
    default 148

config LV_Z_BITS_PER_PIXEL
    default 1

choice LV_COLOR_DEPTH
    default LV_COLOR_DEPTH_1
endchoice

endif # SSD1306

if ZMK_RGB_UNDERGLOW

config WS2812_STRIP
    default y

endif # ZMK_RGB_UNDERGLOW

if ZMK_BACKLIGHT

config PWM
    default y

config LED_PWM
    default y

endif # ZMK_BACKLIGHT

endif # SHIELD_SOFLE_CUSTOM_LEFT || SHIELD_SOFLE_CUSTOM_RIGHT
```

## config/west.yml
```yaml
manifest:
  defaults:
    revision: main
  remotes:
    - name: blaster4385
      url-base: https://github.com/Blaster4385
    - name: zmkfirmware
      url-base: https://github.com/zmkfirmware
    - name: m165437
      url-base: https://github.com/M165437
    - name: machetie
      url-base: https://github.com/machetie
    - name: carrefinho
      url-base: https://github.com/carrefinho  
    # Additional modules containing boards/shields/custom code can be listed here as well
    # See https://docs.zephyrproject.org/3.2.0/develop/west/manifest.html#projects
  projects:
    - name: zmk
      remote: blaster4385
      import: app/west.yml
    - name: nice-view-gem
      remote: m165437
      revision: main
    - name: prospector-zmk-module
      remote: carrefinho
      revision: feat/new-status-screens
  self:
    path: config
```
